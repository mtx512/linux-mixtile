## drivers/net/wireless/rtl8188/Kconfig
```kconfig
config RTL8188CUS
	tristate "Realtek RTL8188CUS USB WiFi"
	depends on USB
	---help---
	  Help message of RTL8188CUS
```

## drivers/net/wireless/rtl8188eus/Kconfig
```kconfig
config RTL8188EU
	tristate "Realtek RTL8188EUS USB WiFi"
	depends on USB
	---help---
	  Help message of RTL8188EU
```
